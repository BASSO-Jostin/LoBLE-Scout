## src/Mon_Apk/build/Kconfig/arch/Kconfig
```kconfig
# Load arch Kconfig descriptions.
osource "D:/Git/zephyrprojet/v3.7/zephyr/arch/x86/Kconfig"
osource "D:/Git/zephyrprojet/v3.7/zephyr/arch/xtensa/Kconfig"
osource "D:/Git/zephyrprojet/v3.7/zephyr/arch/sparc/Kconfig"
osource "D:/Git/zephyrprojet/v3.7/zephyr/arch/riscv/Kconfig"
osource "D:/Git/zephyrprojet/v3.7/zephyr/arch/posix/Kconfig"
osource "D:/Git/zephyrprojet/v3.7/zephyr/arch/nios2/Kconfig"
osource "D:/Git/zephyrprojet/v3.7/zephyr/arch/mips/Kconfig"
osource "D:/Git/zephyrprojet/v3.7/zephyr/arch/arm64/Kconfig"
osource "D:/Git/zephyrprojet/v3.7/zephyr/arch/arm/Kconfig"
osource "D:/Git/zephyrprojet/v3.7/zephyr/arch/arc/Kconfig"
```

## src/Mon_Apk/build/Kconfig/soc/Kconfig
```kconfig
# Load Zephyr SoC Kconfig descriptions.
osource "D:/Git/zephyrprojet/v3.7/zephyr/soc/xlnx/zynqmp/Kconfig"
osource "D:/Git/zephyrprojet/v3.7/zephyr/soc/xlnx/zynq7000/Kconfig"
osource "D:/Git/zephyrprojet/v3.7/zephyr/soc/xen/Kconfig"
osource "D:/Git/zephyrprojet/v3.7/zephyr/soc/ti/simplelink/Kconfig"
osource "D:/Git/zephyrprojet/v3.7/zephyr/soc/ti/lm3s6965/Kconfig"
osource "D:/Git/zephyrprojet/v3.7/zephyr/soc/ti/k3/Kconfig"
osource "D:/Git/zephyrprojet/v3.7/zephyr/soc/telink/tlsr/Kconfig"
osource "D:/Git/zephyrprojet/v3.7/zephyr/soc/starfive/jh71xx/Kconfig"
osource "D:/Git/zephyrprojet/v3.7/zephyr/soc/st/stm32/Kconfig"
osource "D:/Git/zephyrprojet/v3.7/zephyr/soc/snps/qemu_arc/Kconfig"
osource "D:/Git/zephyrprojet/v3.7/zephyr/soc/snps/nsim/arc_v/Kconfig"
osource "D:/Git/zephyrprojet/v3.7/zephyr/soc/snps/nsim/arc_classic/Kconfig"
osource "D:/Git/zephyrprojet/v3.7/zephyr/soc/snps/hsdk4xd/Kconfig"
osource "D:/Git/zephyrprojet/v3.7/zephyr/soc/snps/hsdk/Kconfig"
osource "D:/Git/zephyrprojet/v3.7/zephyr/soc/snps/emsk/Kconfig"
osource "D:/Git/zephyrprojet/v3.7/zephyr/soc/snps/emsdp/Kconfig"
osource "D:/Git/zephyrprojet/v3.7/zephyr/soc/snps/arc_iot/Kconfig"
osource "D:/Git/zephyrprojet/v3.7/zephyr/soc/silabs/Kconfig"
osource "D:/Git/zephyrprojet/v3.7/zephyr/soc/sifive/sifive_freedom/Kconfig"
osource "D:/Git/zephyrprojet/v3.7/zephyr/soc/rockchip/Kconfig"
osource "D:/Git/zephyrprojet/v3.7/zephyr/soc/renode/riscv_virtual/Kconfig"
osource "D:/Git/zephyrprojet/v3.7/zephyr/soc/renesas/smartbond/Kconfig"
osource "D:/Git/zephyrprojet/v3.7/zephyr/soc/renesas/rzt2m/Kconfig"
osource "D:/Git/zephyrprojet/v3.7/zephyr/soc/renesas/rcar/Kconfig"
osource "D:/Git/zephyrprojet/v3.7/zephyr/soc/renesas/ra/Kconfig"
osource "D:/Git/zephyrprojet/v3.7/zephyr/soc/raspberrypi/Kconfig"
osource "D:/Git/zephyrprojet/v3.7/zephyr/soc/quicklogic/eos_s3/Kconfig"
osource "D:/Git/zephyrprojet/v3.7/zephyr/soc/qemu/virt_riscv/Kconfig"
osource "D:/Git/zephyrprojet/v3.7/zephyr/soc/qemu/malta/Kconfig"
osource "D:/Git/zephyrprojet/v3.7/zephyr/soc/openisa/rv32m1/Kconfig"
osource "D:/Git/zephyrprojet/v3.7/zephyr/soc/nxp/s32/Kconfig"
osource "D:/Git/zephyrprojet/v3.7/zephyr/soc/nxp/rw/Kconfig"
osource "D:/Git/zephyrprojet/v3.7/zephyr/soc/nxp/mcx/Kconfig"
osource "D:/Git/zephyrprojet/v3.7/zephyr/soc/nxp/lpc/Kconfig"
osource "D:/Git/zephyrprojet/v3.7/zephyr/soc/nxp/layerscape/Kconfig"
osource "D:/Git/zephyrprojet/v3.7/zephyr/soc/nxp/kinetis/Kconfig"
osource "D:/Git/zephyrprojet/v3.7/zephyr/soc/nxp/imxrt/Kconfig"
osource "D:/Git/zephyrprojet/v3.7/zephyr/soc/nxp/imx/Kconfig"
osource "D:/Git/zephyrprojet/v3.7/zephyr/soc/nuvoton/numicro/Kconfig"
osource "D:/Git/zephyrprojet/v3.7/zephyr/soc/nuvoton/numaker/Kconfig"
osource "D:/Git/zephyrprojet/v3.7/zephyr/soc/nuvoton/npcx/Kconfig"
osource "D:/Git/zephyrprojet/v3.7/zephyr/soc/nordic/Kconfig"
osource "D:/Git/zephyrprojet/v3.7/zephyr/soc/neorv32/Kconfig"
osource "D:/Git/zephyrprojet/v3.7/zephyr/soc/native/inf_clock/Kconfig"
osource "D:/Git/zephyrprojet/v3.7/zephyr/soc/microchip/miv/Kconfig"
osource "D:/Git/zephyrprojet/v3.7/zephyr/soc/microchip/mec/Kconfig"
osource "D:/Git/zephyrprojet/v3.7/zephyr/soc/mediatek/mtk_adsp/Kconfig"
osource "D:/Git/zephyrprojet/v3.7/zephyr/soc/lowrisc/opentitan/Kconfig"
osource "D:/Git/zephyrprojet/v3.7/zephyr/soc/litex/litex_vexriscv/Kconfig"
osource "D:/Git/zephyrprojet/v3.7/zephyr/soc/ite/ec/Kconfig"
osource "D:/Git/zephyrprojet/v3.7/zephyr/soc/intel/raptor_lake/Kconfig"
osource "D:/Git/zephyrprojet/v3.7/zephyr/soc/intel/lakemont/Kconfig"
osource "D:/Git/zephyrprojet/v3.7/zephyr/soc/intel/intel_socfpga_std/Kconfig"
osource "D:/Git/zephyrprojet/v3.7/zephyr/soc/intel/intel_socfpga/Kconfig"
osource "D:/Git/zephyrprojet/v3.7/zephyr/soc/intel/intel_niosv/Kconfig"
osource "D:/Git/zephyrprojet/v3.7/zephyr/soc/intel/intel_ish/Kconfig"
osource "D:/Git/zephyrprojet/v3.7/zephyr/soc/intel/intel_adsp/Kconfig"
osource "D:/Git/zephyrprojet/v3.7/zephyr/soc/intel/elkhart_lake/Kconfig"
osource "D:/Git/zephyrprojet/v3.7/zephyr/soc/intel/atom/Kconfig"
osource "D:/Git/zephyrprojet/v3.7/zephyr/soc/intel/apollo_lake/Kconfig"
osource "D:/Git/zephyrprojet/v3.7/zephyr/soc/intel/alder_lake/Kconfig"
osource "D:/Git/zephyrprojet/v3.7/zephyr/soc/infineon/cat3/Kconfig"
osource "D:/Git/zephyrprojet/v3.7/zephyr/soc/infineon/cat1b/Kconfig"
osource "D:/Git/zephyrprojet/v3.7/zephyr/soc/infineon/cat1a/Kconfig"
osource "D:/Git/zephyrprojet/v3.7/zephyr/soc/gd/gd32/Kconfig"
osource "D:/Git/zephyrprojet/v3.7/zephyr/soc/gaisler/leon3/Kconfig"
osource "D:/Git/zephyrprojet/v3.7/zephyr/soc/gaisler/gr716a/Kconfig"
osource "D:/Git/zephyrprojet/v3.7/zephyr/soc/espressif/Kconfig"
osource "D:/Git/zephyrprojet/v3.7/zephyr/soc/ene/kb1200/Kconfig"
osource "D:/Git/zephyrprojet/v3.7/zephyr/soc/efinix/sapphire/Kconfig"
osource "D:/Git/zephyrprojet/v3.7/zephyr/soc/cdns/xtensa_sample_controller/Kconfig"
osource "D:/Git/zephyrprojet/v3.7/zephyr/soc/cdns/dc233c/Kconfig"
osource "D:/Git/zephyrprojet/v3.7/zephyr/soc/brcm/bcmvk/Kconfig"
osource "D:/Git/zephyrprojet/v3.7/zephyr/soc/brcm/bcm2712/Kconfig"
osource "D:/Git/zephyrprojet/v3.7/zephyr/soc/brcm/bcm2711/Kconfig"
osource "D:/Git/zephyrprojet/v3.7/zephyr/soc/atmel/sam0/Kconfig"
osource "D:/Git/zephyrprojet/v3.7/zephyr/soc/atmel/sam/Kconfig"
osource "D:/Git/zephyrprojet/v3.7/zephyr/soc/aspeed/Kconfig"
osource "D:/Git/zephyrprojet/v3.7/zephyr/soc/arm/Kconfig"
osource "D:/Git/zephyrprojet/v3.7/zephyr/soc/arm/beetle/Kconfig"
osource "D:/Git/zephyrprojet/v3.7/zephyr/soc/andestech/Kconfig"
osource "D:/Git/zephyrprojet/v3.7/zephyr/soc/ambiq/Kconfig"
osource "D:/Git/zephyrprojet/v3.7/zephyr/soc/altr/zephyr_nios2f/Kconfig"
osource "D:/Git/zephyrprojet/v3.7/zephyr/soc/altr/qemu_nios2/Kconfig"
osource "D:/Git/zephyrprojet/v3.7/zephyr/soc/adi/max32/Kconfig"
```
